## zephyr/boards/xtensa/m5stack_atoms3/Kconfig.board
```kconfig
config BOARD_M5STACK_ATOMS3
    bool "M5Stack AtomS3 (ESP32-S3, 8MB Flash)"
    depends on SOC_ESP32S3
```

## zephyr/boards/xtensa/m5stack_atoms3/Kconfig.defconfig
```kconfig
if BOARD_M5STACK_ATOMS3

config BOARD
    default "m5stack_atoms3"

config SOC_SERIES
    default "esp32s3"

config SOC
    default "esp32s3"

# AtomS3 has no PSRAM; use 8MB internal flash only
config FLASH_SIZE
    default 0x800000

config ESP32_PHY_MAX_WIFI_TX_POWER
    default 20

endif # BOARD_M5STACK_ATOMS3
```

## zephyr/boards/xtensa/m5stack_atoms3/m5stack_atoms3_defconfig
```kconfig
CONFIG_SOC_SERIES_ESP32S3=y
CONFIG_SOC_ESP32S3=y
CONFIG_BOARD_M5STACK_ATOMS3=y

# ESP32-S3 dual core: run NFC on core 0, UI on core 1
CONFIG_MP_MAX_NUM_CPUS=2
CONFIG_SMP=y

# 240 MHz
CONFIG_SYS_CLOCK_HW_CYCLES_PER_SEC=240000000

# USB native CDC (no external UART chip on AtomS3)
CONFIG_ESP_CONSOLE_USB_SERIAL_JTAG=y
CONFIG_USB_DEVICE_STACK=y
CONFIG_USB_CDC_ACM=y
```

## zephyr/boards/xtensa/m5stack_sticks3/Kconfig.board
```kconfig
config BOARD_M5STACK_STICKS3
    bool "M5Stack StickS3 / StickC Plus2 (ESP32-S3)"
    depends on SOC_ESP32S3
```

## zephyr/boards/xtensa/m5stack_sticks3/Kconfig.defconfig
```kconfig
if BOARD_M5STACK_STICKS3

config BOARD
    default "m5stack_sticks3"

config SOC_SERIES
    default "esp32s3"

config SOC
    default "esp32s3"

endif # BOARD_M5STACK_STICKS3
```

## zephyr/boards/xtensa/m5stack_sticks3/m5stack_sticks3_defconfig
```kconfig
CONFIG_SOC_SERIES_ESP32S3=y
CONFIG_SOC_ESP32S3=y
CONFIG_BOARD_M5STACK_STICKS3=y
CONFIG_MP_MAX_NUM_CPUS=2
CONFIG_SMP=y
CONFIG_SYS_CLOCK_HW_CYCLES_PER_SEC=240000000
CONFIG_ESP_CONSOLE_USB_SERIAL_JTAG=y
CONFIG_USB_DEVICE_STACK=y
CONFIG_USB_CDC_ACM=y
```

## zephyr/drivers/grove_nfc/Kconfig
```kconfig
config GROVENFC_DRIVER
    bool "Grove NFC I2C driver"
    default y
    depends on I2C
    help
      Low-level Zephyr driver for the Seeed Grove NFC module (I2C address 0x48).
      Provides register read/write and RF transceive primitives used by the
      application-level NFC reader and emulator modules.
```
